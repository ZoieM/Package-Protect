/**
 * @cliArgs --device "CC3220SF" --package "Default" --part "Default"
 * @versions {"data":"2020032715","timestamp":"2020032715","tool":"1.4.0+1297","templates":"2020032715"}
 */

/**
 * These are the peripherals and settings in this configuration
 */
const iGPIO1    = scripting.addPeripheral("GPIO");
iGPIO1.$numPins = 9;
iGPIO1["0"].io  = "output";
iGPIO1["1"].io  = "output";
iGPIO1["2"].io  = "output";
iGPIO1["3"].io  = "output";
iGPIO1.$name    = "Keypad";
const iGPIO2    = scripting.addPeripheral("GPIO");
iGPIO2["0"].io  = "output";
iGPIO2.$name    = "Lock";
const iUART1    = scripting.addPeripheral("UART");
iUART1.$name    = "Screen";

/**
 * Pinmux solution for unlocked pins/peripherals. This ensures that minor changes to the automatic solver in a future
 * version of the tool will not impact the pinmux you originally saw.  These lines can be completely deleted in order to
 * re-solve from scratch.
 */
iGPIO1["0"].$suggestSolution = "1";
iGPIO1["1"].$suggestSolution = "2";
iGPIO1["2"].$suggestSolution = "3";
iGPIO1["3"].$suggestSolution = "4";
iGPIO1["4"].$suggestSolution = "5";
iGPIO1["5"].$suggestSolution = "6";
iGPIO1["6"].$suggestSolution = "7";
iGPIO1["7"].$suggestSolution = "8";
iGPIO1["8"].$suggestSolution = "15";
iGPIO2["0"].$suggestSolution = "16";
iUART1.$suggestSolution      = "UART1";
iUART1.RTS.$suggestSolution  = "50";
iUART1.CTS.$suggestSolution  = "61";
iUART1.TX.$suggestSolution   = "55";
iUART1.RX.$suggestSolution   = "57";
